## arch/arm/soc/arm/mps2/Kconfig.defconfig.mps2_an521
```kconfig
#
# Copyright (c) 2018 Arm Limited
#
# SPDX-License-Identifier: Apache-2.0
#

if SOC_MPS2_AN521

config SOC
	default "mps2_an521"

config NUM_IRQS
	int
	default 96

if ARM_SECURE_FIRMWARE
config BUILD_HEX_OUTPUT
	def_bool y
endif

endif
```

## arch/arm/soc/arm/musca_a/Kconfig.series
```kconfig
#
# Copyright (c) 2018 Linaro Limited
#
# SPDX-License-Identifier: Apache-2.0
#

config SOC_SERIES_MUSCA
	bool "ARM v2m MUSCA MCU Series"
	depends on ARM
	select SOC_FAMILY_ARM
	select CPU_HAS_SYSTICK
	select GPIO_MMIO32 if GPIO
	help
	  Enable support for ARM MPS2 MCU Series
```

## boards/arm/v2m_musca/Kconfig.defconfig
```kconfig
#
# Copyright (c) 2018 Linaro Limited
#
# SPDX-License-Identifier: Apache-2.0
#

if BOARD_MUSCA_A

config BOARD
	default "musca_a"

if GPIO

config GPIO_CMSDK_AHB
	def_bool y

config GPIO_CMSDK_AHB_PORT0
	def_bool y

endif # GPIO

if PINMUX

config PINMUX_MPS2
	def_bool y

endif # PINMUX

if SERIAL

config UART_PL011
	def_bool y

config UART_INTERRUPT_DRIVEN
	def_bool y

config UART_PL011_PORT0
	def_bool y

config UART_PL011_PORT1
	def_bool y

endif # SERIAL

if COUNTER

if COUNTER_TMR_CMSDK_APB

config COUNTER_TMR_CMSDK_APB_0
	def_bool y

config COUNTER_TMR_CMSDK_APB_1
	def_bool y

endif # COUNTER_TMR_CMSDK_APB

if TIMER_TMR_CMSDK_APB

config TIMER_TMR_CMSDK_APB_0
	def_bool y

config TIMER_TMR_CMSDK_APB_1
	def_bool y

endif # TIMER_TMR_CMSDK_APB

if COUNTER_DTMR_CMSDK_APB

config COUNTER_DTMR_CMSDK_APB_0
	def_bool y

endif # COUNTER_DTMR_CMSDK_APB

if TIMER_DTMR_CMSDK_APB

config TIMER_DTMR_CMSDK_APB_0
	def_bool y

endif # TIMER_DTMR_CMSDK_APB

endif # COUNTER

if I2C

config I2C_SBCON
	def_bool y

config I2C_SBCON_0
	def_bool y

config I2C_SBCON_1
	def_bool y

endif # I2C

endif
```

## boards/arm/v2m_musca/v2m_musca_nonsecure_defconfig
```kconfig
#
# Copyright (c) 2018 Linaro Limited
#
# SPDX-License-Identifier: Apache-2.0
#

CONFIG_ARM=y
CONFIG_SOC_FAMILY_ARM=y
CONFIG_SOC_SERIES_MUSCA=y
CONFIG_SOC_V2M_MUSCA_A=y
CONFIG_BOARD_MUSCA_A=y
CONFIG_CORTEX_M_SYSTICK=y
CONFIG_RUNTIME_NMI=y
CONFIG_ARMV8_M_MAINLINE=y
CONFIG_ARM_NONSECURE_FIRMWARE=y

# GPIOs
CONFIG_GPIO=y

# PinMuxing
CONFIG_PINMUX=y

# Serial
CONFIG_CONSOLE=y
CONFIG_UART_CONSOLE=y
CONFIG_SERIAL=y

# Watchdog
CONFIG_WATCHDOG=y

CONFIG_I2C=y

CONFIG_XIP_COPY=n
```

## dts/bindings/serial/cadence,pl011.yaml
```yaml
---
title: Cadence PL011 UART
id: cadence,pl011
version: 0.1

description: >
    This binding gives a base representation of the Cadence PL011 Uart

inherits:
    !include uart.yaml

properties:
    compatible:
      type: string
      category: required
      description: compatible strings
      constraint: "cadence,pl011"

    reg:
      type: array
      description: mmio register space
      generation: define
      category: required

    interrupts:
      type: array
      category: required
      description: required interrupts
      generation: define
...
```

## subsys/cprng/Kconfig
```kconfig
# Kconfig - CPRNG configuration options
#
# Copyright (c) 2018 Linaro Ltd.
#
# SPDX-License-Identifier: Apache-2.0

menuconfig CPRNG
	bool "CPRNG Generators"
	help
	  Enable Cryptographic Pseudo Random Number Generators
	  (CPRNG).  These generators take a source of entropy from an
	  entropy driver, and generate a stream of bytes usable for
	  cryptographic purposes.  Select one of the available drivers
	  below.
```

## sample.yaml
```
sample:
    description: Sample app that sends messages between the two cores on
        the cy8ckit_062_wifi_bt using a mailbox. Server part running on
        the cy8ckit_062_wifi_bt_m0.
    name: IPM PSoC6 CM0 Mailbox Sample
tests:
    test:
        platform_whitelist: cy8ckit_062_wifi_bt_m0
        tags: samples ipm
```

## prj.conf
```kconfig
CONFIG_STDOUT_CONSOLE=y
CONFIG_PRINTK=y
CONFIG_IPM=y
CONFIG_IPM_PSOC6=y
CONFIG_IPM_CONSOLE_SENDER=y
CONFIG_CONSOLE=y
CONFIG_SERIAL=y
```

## src/main_server.c
```c
/*
 * Copyright (c) 2018, Cypress Semiconductor
 *
 * SPDX-License-Identifier: Apache-2.0
 */
#include <zephyr.h>

#include "cy_sysint.h"
#include "cy_wdt.h"
#include <ipm.h>
#include <device.h>
#include <init.h>
#include <misc/printk.h>
#include <string.h>

#define SLEEP_TIME 10000

void message_ipm_notify_callback(void *context, u32_t id, volatile void *data)
{
	u32_t *data32 = (u32_t *)data;

	printk("Received %u via IPC\n", *data32);
}

void main(void)
{
	struct device *ipm;

	/* Disable watchdog */
	Cy_WDT_Unlock();
	Cy_WDT_Disable();

	ipm = device_get_binding(PSOC6_IPM7_LABEL);
	ipm_register_callback(ipm, message_ipm_notify_callback, NULL);
	ipm_set_enabled(ipm, 1);

	printk("PSoC6 IPM Server example has started\n");

	/* Enable CM4 */
	Cy_SysEnableCM4(CONFIG_SLAVE_BOOT_ADDRESS_PSOC6);

	while (1) {
		k_sleep(SLEEP_TIME);
	}
}
```

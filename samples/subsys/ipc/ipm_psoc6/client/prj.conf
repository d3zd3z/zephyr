## sample.yaml
```
sample:
    description: Sample app that sends messages between the two cores on
        the cy8ckit_062_wifi_bt using a mailbox. Client part running on
        the cy8ckit_062_wifi_bt_m4.
    name: IPM PSoC6 CM4 Mailbox Sample
tests:
    test:
        platform_whitelist: cy8ckit_062_wifi_bt_m4
        tags: samples ipm
```

## prj.conf
```kconfig
CONFIG_PRINTK=y
CONFIG_IPM=y
CONFIG_IPM_PSOC6=y
CONFIG_IPM_CONSOLE_RECEIVER=y
CONFIG_TIMESLICE_SIZE=1
CONFIG_MAIN_STACK_SIZE=2048
```

## src/main_client.c
```c
/*
 * Copyright (c) 2018, Cypress Semiconductor
 *
 * SPDX-License-Identifier: Apache-2.0
 */

#include "cy_sysint.h"
#include <misc/printk.h>
#include <zephyr.h>
#include <ipm.h>

#define SLEEP_TIME 2000

void message_ipm_release_callback(void *context, u32_t id, volatile void *data)
{
	int *flag = context;

	printk("Received Release acknowledge via IPC\n");
	*flag = 1;
}

void main(void)
{
	struct device *ipm;
	int ipm_error;
	int flag = 1;
	u32_t counter = 0;

	ipm = device_get_binding(PSOC6_IPM7_LABEL);
	ipm_register_callback(ipm, message_ipm_release_callback, &flag);

	printk("PSoC6 IPM Client example has started\n");

	while (1) {
		if (flag) {
			flag = 0;
			printk("sending messages \" %u \" to CM0p\n", counter);
			ipm_error = ipm_send(ipm, 1, 0, &counter, 4);

			if (ipm_error != 0) {
				printk("ipm_send returned error %i\n",
					ipm_error);
			}
			counter++;
		}
		k_sleep(SLEEP_TIME);
	}
}
```

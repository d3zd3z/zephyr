## Kconfig
```
# Configure the bootloader

choice
prompt "Bootloader signature type"
default BOOT_RSA_SIGNATURE

config BOOT_RSA_SIGNATURE
	bool "Sign image with RSA"

config BOOT_ECDSA_SIGNATURE
	bool "sign image with ECDSA"

endchoice
```

## prj.conf
```kconfig
CONFIG_CONSOLE_HANDLER=y
CONFIG_CONSOLE_HANDLER_SHELL=y
### CONFIG_ENABLE_SHELL=y
CONFIG_PRINTK=y

### Increase the default stack size
CONFIG_MAIN_STACK_SIZE=10240

### Use a large enough heap for the crypto allocations
CONFIG_HEAP_MEM_POOL_SIZE=16384

### Enable MBED TLS to get the code for verifying the signatures.
CONFIG_MBEDTLS=y
CONFIG_MBEDTLS_BUILTIN=y
CONFIG_MBEDTLS_CFG_FILE="config-boot.h"

### Enable the STM flash device
CONFIG_FLASH=y
CONFIG_SOC_FLASH_STM32F4=y

CONFIG_CHAIN_BOOT=y
CONFIG_BOOT_LOADER=y
CONFIG_BOOT_VERIFY_ECDSA_SIGNATURE=y
```

## src/main.c
```c
/*
 * Copyright (c) 2012-2014 Wind River Systems, Inc.
 *
 * Licensed under the Apache License, Version 2.0 (the "License");
 * you may not use this file except in compliance with the License.
 * You may obtain a copy of the License at
 *
 *     http://www.apache.org/licenses/LICENSE-2.0
 *
 * Unless required by applicable law or agreed to in writing, software
 * distributed under the License is distributed on an "AS IS" BASIS,
 * WITHOUT WARRANTIES OR CONDITIONS OF ANY KIND, either express or implied.
 * See the License for the specific language governing permissions and
 * limitations under the License.
 */

#include <zephyr.h>
#include <flash.h>
#include <device.h>
#include <misc/printk.h>
#include <asm_inline.h>

#include <boot_config.h>
#include <boot/update.h>
#include <boot/chain_boot.h>
#include <boot/flash_map.h>
#include <boot/loader.h>

/* TODO: Basic configuration for Carbon 96b flash.
 */
static const struct flash_area flash_areas[] = {
	{
		.fa_flash_id = FLASH_AREA_IMAGE_0,
		.fa_off = 128*1024,
		.fa_size = 128*1024,
	},
	{
		.fa_flash_id = FLASH_AREA_IMAGE_1,
		.fa_off = 2*128*1024,
		.fa_size = 128*1024,
	},
	{
		.fa_flash_id = FLASH_AREA_IMAGE_SCRATCH,
		.fa_off = 3*128*1024,
		.fa_size = 128*1024,
	},
	{
		.fa_size = 0,
	},
};

static const uint8_t slot_areas[] = { 0, 1 };
static const struct boot_req carbon_req = {
	.br_area_descs = flash_areas,
	.br_slot_areas = slot_areas,
	.br_num_image_areas = 3,
	.br_scratch_area_idx = 2,
	.br_img_sz = 128*1024,
};


void main(void)
{
	struct device *flash_dev;
	/* void *base; */
	struct boot_rsp rsp;
	int res;

	printk("------------------------------------------------------------\n");
	printk("Bootloader on %s\n", CONFIG_ARCH);

	flash_dev = device_get_binding(BOOT_FLASH_DEVICE);
	if (!flash_dev) {
		printk(BOOT_FLASH_DEVICE " flash device not found\n");
		while (1)
			;
	}

	res = boot_go(flash_dev, &carbon_req, &rsp);
	if (res) {
		printk("Failed to find bootable image\n");
		while (1)
			;
	}

	printk("Boot: 0x%x\n", rsp.br_image_addr);
	chain_boot((void *) (rsp.br_image_addr + BOOT_FLASH_BASE));

#if 0
	/*
	 * Determine if there is a bootable image.
	 */
	base = boot_find_image(flash_dev);
	printk("Boot: %p\n", base);
	chain_boot(base);
#endif
}
```

## src/image_ec.c
```c
/*
 * ??? TODO: Fix license for Zephyr inclusion.
 *
 * Licensed to the Apache Software Foundation (ASF) under one
 * or more contributor license agreements.  See the NOTICE file
 * distributed with this work for additional information
 * regarding copyright ownership.  The ASF licenses this file
 * to you under the Apache License, Version 2.0 (the
 * "License"); you may not use this file except in compliance
 * with the License.  You may obtain a copy of the License at
 *
 *  http://www.apache.org/licenses/LICENSE-2.0
 *
 * Unless required by applicable law or agreed to in writing,
 * software distributed under the License is distributed on an
 * "AS IS" BASIS, WITHOUT WARRANTIES OR CONDITIONS OF ANY
 * KIND, either express or implied.  See the License for the
 * specific language governing permissions and limitations
 * under the License.
 */

#include <zephyr.h>
#include <misc/printk.h>

#include <mbedtls/sha256.h>
#include <mbedtls/ecdsa.h>
#include <mbedtls/oid.h>
#include <mbedtls/asn1.h>
#include <string.h>

#include "image_rsa.h"

extern void init_boot_alloc(void);

extern unsigned char root_ec_pub_der[];
extern unsigned int root_ec_pub_der_len;

/*
 * Declaraing these like this adds NULL termination.
 */
static const uint8_t ec_pubkey_oid[] = MBEDTLS_OID_EC_ALG_UNRESTRICTED;
static const uint8_t ec_secp224r1_oid[] = MBEDTLS_OID_EC_GRP_SECP224R1;

/*
 * Parse the public key used for signing.
 */
static int
parse_eckey(mbedtls_ecdsa_context *ctx, uint8_t **p, uint8_t *end)
{
	size_t len;
	mbedtls_asn1_buf alg;
	mbedtls_asn1_buf param;

	if (mbedtls_asn1_get_tag(p, end, &len,
				 (MBEDTLS_ASN1_CONSTRUCTED |
				  MBEDTLS_ASN1_SEQUENCE))) {
		return -1;
	}
	end = *p + len;

	if (mbedtls_asn1_get_alg(p, end, &alg, &param)) {
		return -2;
	}
	if (alg.len != sizeof(ec_pubkey_oid) - 1 ||
	    memcmp(alg.p, ec_pubkey_oid, sizeof(ec_pubkey_oid) - 1)) {
		return -3;
	}
	if (param.len != sizeof (ec_secp224r1_oid) - 1 ||
	    memcmp(param.p, ec_secp224r1_oid, sizeof(ec_secp224r1_oid) - 1)) {
		return -4;
	}

	if (mbedtls_ecp_group_load(&ctx->grp, MBEDTLS_ECP_DP_SECP224R1)) {
		return -5;
	}

	if (mbedtls_asn1_get_bitstring_null(p, end, &len)) {
		return -6;
	}
	if (*p + len != end) {
		return -7;
	}

	if (mbedtls_ecp_point_read_binary(&ctx->grp, &ctx->Q, *p, end - *p)) {
		return -8;
	}

	if (mbedtls_ecp_check_pubkey(&ctx->grp, &ctx->Q)) {
		return -9;
	}
	return 0;
}

static int
cmp_sig(mbedtls_ecdsa_context *ctx, uint8_t *hash, uint32_t hlen,
	uint8_t *sig, int slen)
{
	return mbedtls_ecdsa_read_signature(ctx, hash, hlen, sig, slen);
}

int
bootutil_ec_verify_sig(uint8_t *hash, uint32_t hlen, uint8_t *sig, int slen,
		       uint8_t key_id)
{
	int rc;
	uint8_t *cp;
	uint8_t *end;
	mbedtls_ecdsa_context ctx;

	// TODO: How to pass this through. It seems to vary a bit.
	// The code is prepared to zero-pad, and maybe that is the
	// right thing to do.
	slen = 62;

	init_boot_alloc();

	mbedtls_ecdsa_init(&ctx);
	cp = root_ec_pub_der;
	end = root_ec_pub_der + root_ec_pub_der_len;

	rc = parse_eckey(&ctx, &cp, end);
	if (rc) {
		return -1;
	}

	while (sig[slen - 1] == '\0') {
		slen--;
	}
	rc = cmp_sig(&ctx, hash, hlen, sig, slen);
	mbedtls_ecdsa_free(&ctx);

	return rc;
}
```

## src/image_ec.h
```c
/*
 * ??? TODO: Fix license for Zephyr inclusion.
 *
 * Licensed to the Apache Software Foundation (ASF) under one
 * or more contributor license agreements.  See the NOTICE file
 * distributed with this work for additional information
 * regarding copyright ownership.  The ASF licenses this file
 * to you under the Apache License, Version 2.0 (the
 * "License"); you may not use this file except in compliance
 * with the License.  You may obtain a copy of the License at
 *
 *  http://www.apache.org/licenses/LICENSE-2.0
 *
 * Unless required by applicable law or agreed to in writing,
 * software distributed under the License is distributed on an
 * "AS IS" BASIS, WITHOUT WARRANTIES OR CONDITIONS OF ANY
 * KIND, either express or implied.  See the License for the
 * specific language governing permissions and limitations
 * under the License.
 */

#ifndef __BOOT_IMAGE_RSA_H__
#define __BOOT_IMAGE_RSA_H__

int
bootutil_ec_verify_sig(uint8_t *hash, uint32_t hlen, uint8_t *sig, int slen,
		       uint8_t key_id);

#endif /* __BOOT_IMAGE_RSA_H__ */
```

## src/image_rsa.c
```c
/*
 * ??? TODO: Fix license for Zephyr inclusion.
 *
 * Licensed to the Apache Software Foundation (ASF) under one
 * or more contributor license agreements.  See the NOTICE file
 * distributed with this work for additional information
 * regarding copyright ownership.  The ASF licenses this file
 * to you under the Apache License, Version 2.0 (the
 * "License"); you may not use this file except in compliance
 * with the License.  You may obtain a copy of the License at
 *
 *  http://www.apache.org/licenses/LICENSE-2.0
 *
 * Unless required by applicable law or agreed to in writing,
 * software distributed under the License is distributed on an
 * "AS IS" BASIS, WITHOUT WARRANTIES OR CONDITIONS OF ANY
 * KIND, either express or implied.  See the License for the
 * specific language governing permissions and limitations
 * under the License.
 */

#include <zephyr.h>
#include <misc/printk.h>

#include <mbedtls/rsa.h>
#include <mbedtls/asn1.h>
#include <string.h>

#include "image_rsa.h"

static const uint8_t sha256_oid[] = {
	0x30, 0x31, 0x30, 0x0d, 0x06, 0x09, 0x60, 0x86,
	0x48, 0x01, 0x65, 0x03, 0x04, 0x02, 0x01, 0x05,
	0x00, 0x04, 0x20
};

extern unsigned char root_pub_der[];
extern unsigned int root_pub_der_len;

extern void * (*mbedtls_calloc)( size_t n, size_t size );
extern void (*mbedtls_free)( void *ptr );

void *boot_calloc(size_t n, size_t size)
{
	size_t total = n * size;
	void *buf = k_malloc(total);
	if (!buf) {
		printk("Failure to allocate %d bytes\n", total);
	}
	memset(buf, 0, size);
	return buf;
}

void boot_free(void *ptr)
{
	k_free(ptr);
}

/*
 * Parse the public key used for signing. Simple RSA format (DER).
 */
static int
bootutil_parse_rsakey(mbedtls_rsa_context *ctx, uint8_t **p, uint8_t *end)
{
	int rc;
	size_t len;

	mbedtls_calloc = boot_calloc;
	mbedtls_free = boot_free;

	if ((rc = mbedtls_asn1_get_tag(p, end, &len,
				       (MBEDTLS_ASN1_CONSTRUCTED |
					MBEDTLS_ASN1_SEQUENCE))) != 0) {
		return -1;
	}

	if (*p + len != end) {
		return -2;
	}

	if ((rc = mbedtls_asn1_get_mpi(p, end, &ctx->N)) != 0 ||
	    (rc = mbedtls_asn1_get_mpi(p, end, &ctx->E)) != 0) {
		printk("get mpi error: %d\n", rc);
		return -3;
	}

	if (*p != end) {
		return -4;
	}

	if ((rc = mbedtls_rsa_check_pubkey(ctx)) != 0) {
		printk("check pubkey: %d\n", rc);
		return -5;
	}

	ctx->len = mbedtls_mpi_size(&ctx->N);

	return 0;
}

/*
 * PKCS1.5 using RSA2048 computed over SHA256
 */
static int
cmp_rsasig(mbedtls_rsa_context *ctx, uint8_t *hash, uint32_t hlen,
	   uint8_t *sig)
{
	static uint8_t buf[MBEDTLS_MPI_MAX_SIZE];
	uint8_t *p;

	if (ctx->len != 256) {
		return -1;
	}

	if (mbedtls_rsa_public(ctx, sig, buf)) {
		return -1;
	}

	p = buf;

	if (*p++ != 0 || *p++ != MBEDTLS_RSA_SIGN) {
		return -1;
	}

	while (*p != 0) {
		if (p >= buf + ctx->len - 1 || *p != 0xFF) {
			return -1;
		}
		p++;
	}
	p++;

	if ((p - buf) + sizeof(sha256_oid) + hlen != ctx->len) {
		return -1;
	}

	// TODO: This should be a constant time comparison.
	if (memcmp(p, sha256_oid, sizeof(sha256_oid))) {
		return -1;
	}
	p += sizeof(sha256_oid);

	if (memcmp(p, hash, hlen)) {
		return -1;
	}

	return 0;
}

int
bootutil_verify_sig(uint8_t *hash, uint32_t hlen, uint8_t *sig, int slen,
		    uint8_t key_id)
{
	mbedtls_rsa_context ctx;
	int rc;
	uint8_t *cp;
	uint8_t *end;

	mbedtls_rsa_init(&ctx, 0, 0);

	cp = root_pub_der;
	end = root_pub_der + root_pub_der_len;

	rc = bootutil_parse_rsakey(&ctx, &cp, end);
	if (rc || slen != ctx.len) {
		mbedtls_rsa_free(&ctx);
		return rc;
	}

	rc = cmp_rsasig(&ctx, hash, hlen, sig);
	mbedtls_rsa_free(&ctx);

	return rc;
}
```

## src/image_validate.c
```c
/*
 * ??? TODO: Fix license for Zephyr inclusion.
 *
 * Licensed to the Apache Software Foundation (ASF) under one
 * or more contributor license agreements.  See the NOTICE file
 * distributed with this work for additional information
 * regarding copyright ownership.  The ASF licenses this file
 * to you under the Apache License, Version 2.0 (the
 * "License"); you may not use this file except in compliance
 * with the License.  You may obtain a copy of the License at
 *
 *  http://www.apache.org/licenses/LICENSE-2.0
 *
 * Unless required by applicable law or agreed to in writing,
 * software distributed under the License is distributed on an
 * "AS IS" BASIS, WITHOUT WARRANTIES OR CONDITIONS OF ANY
 * KIND, either express or implied.  See the License for the
 * specific language governing permissions and limitations
 * under the License.
 */

#include <zephyr.h>
#include <misc/printk.h>
#include <boot/signature_header.h>
#include <mbedtls/sha256.h>
#include <string.h>

#include "image_validate.h"
#include "image_rsa.h"
#include "image_ec.h"

static const char magic[8] = "zSiGnata";

/**
 * @brief Search for an image signature.
 *
 * Given a particular flash base address, determine if there is a
 * potentially signed image at that address.  Returns the offset of
 * the signature if there is a valid image at `flash_base`.  If there
 * is no image, returns NO_IMAGE.  *image_size will be set to the
 * image size in bytes.
 */
static struct image_signature *find_signature(uintptr_t flash_base,
					      size_t *image_size)
{
	struct signature_header *head;
	struct image_signature *sig;
	uintptr_t base;

	/**
	 * TODO: We need to make sure that the image is entirely
	 * contained within the flash (possibly this sector, or even
	 * greater depth).
	 */
	head = (struct signature_header *)
		(flash_base + SIGNATURE_HEADER_OFFSET);
	printk("Head: %p\n", head);
	if (head->magic1 != SIGNATURE_HEADER_MAGIC1 ||
	    head->magic2 != SIGNATURE_HEADER_MAGIC2)
		return NO_IMAGE;
	printk("rom_start      = 0x%x\n", head->rom_start);
	printk("rom_end        = 0x%x\n", head->rom_end);
	printk("data_rom_start = 0x%x\n", head->data_rom_start);
	printk("data_ram_start = 0x%x\n", head->data_ram_start);
	printk("data_ram_end   = 0x%x\n", head->data_ram_end);

	/*
	 * Note that the image might not be positioned at its ultimate
	 * destination, so we should based our position merely on
	 * lengths added to the passed base.
	 */
	/*
	 * TODO: Validate that these sizes keep everything in the
	 * section.
	 */
	base = flash_base;
	base += head->rom_end - head->rom_start;
	base += head->data_ram_end - head->data_ram_start;

	*image_size = base - flash_base;

	/* Pad the base to the next 16-byte boundary. */
	base = (base + 15) & ~15;

	/* Determine if we have a signature at this address. */
	printk("Base: 0x%x\n", base);

	sig = (struct image_signature *)base;
	if (memcmp(sig, magic, 8)) {
		printk("No image magic found\n");
		return NO_IMAGE;
	}

	if (sig->version != SIG_VERSION) {
		printk("Signature version mismatch\n");
		return NO_IMAGE;
	}

	if (sig->algo != SIG_ALGO_ECDSA) {
		printk("Unsupported signing algorithm\n");
		return NO_IMAGE;
	}

	if (sig->hash != SIG_HASH_SHA256) {
		printk("Unsupported signing hash function\n");
		return NO_IMAGE;
	}

	return sig;
}

/**
 * @brief compute SHA256 hash of image.
 *
 * @param flash_base The base address of the image
 * @param sig_base   The start address of the signature
 * @param hash_out   The 32-bytes of the computed hash.
 *
 * The image is assumed to occupy the space between the flash_base and
 * the sig_base.
 */
static void img_hash(uintptr_t flash_base, size_t image_size,
		     uint8_t *hash_out)
{
	mbedtls_sha256_context ctx;

	mbedtls_sha256_init(&ctx);
	mbedtls_sha256_starts(&ctx, 0);

	mbedtls_sha256_update(&ctx, (const uint8_t *)flash_base,
			      image_size);
	mbedtls_sha256_finish(&ctx, hash_out);
	mbedtls_sha256_free(&ctx);
}

int
bootutil_img_validate(uintptr_t flash_base)
{
	struct image_signature *sig_base;
	size_t image_size;
	uint8_t hash[32];
	int i;
	int rc;

	sig_base = find_signature(flash_base, &image_size);
	if (sig_base == NO_IMAGE)
		return -1;

	img_hash(flash_base, image_size, hash);
	rc = bootutil_ec_verify_sig(hash, 32, sig_base, 0);
	printk("Bootutil verify: %d\n", rc);

	for (i = 0; i < 32; i++)
		printk(" %x", hash[i]);
	printk("\n");

	if (rc != 0) {
		return -1;
	}

	return 0;
}
```

## src/image_validate.h
```c
/*
 * ??? TODO: Fix license for Zephyr inclusion.
 *
 * Licensed to the Apache Software Foundation (ASF) under one
 * or more contributor license agreements.  See the NOTICE file
 * distributed with this work for additional information
 * regarding copyright ownership.  The ASF licenses this file
 * to you under the Apache License, Version 2.0 (the
 * "License"); you may not use this file except in compliance
 * with the License.  You may obtain a copy of the License at
 *
 *  http://www.apache.org/licenses/LICENSE-2.0
 *
 * Unless required by applicable law or agreed to in writing,
 * software distributed under the License is distributed on an
 * "AS IS" BASIS, WITHOUT WARRANTIES OR CONDITIONS OF ANY
 * KIND, either express or implied.  See the License for the
 * specific language governing permissions and limitations
 * under the License.
 */

#ifndef __BOOT_IMAGE_VALIDATE_H__
#define __BOOT_IMAGE_VALIDATE_H__

#include <stdint.h>

int bootutil_img_validate(uintptr_t flash_base);

#endif /* __BOOT_IMAGE_VALIDATE_H__ */
```

## src/pdump.h
```c
/* Simple hexdump.
 */

#ifndef __PDUMP_H__
#define __PDUMP_H__

void pdump(const void *data, unsigned len);

#endif /* __PDUMP_H__ */
```

## src/root_ec_pub.c
```c
const unsigned char root_ec_pub_der[] = {
  0x30, 0x4e, 0x30, 0x10, 0x06, 0x07, 0x2a, 0x86, 0x48, 0xce, 0x3d, 0x02,
  0x01, 0x06, 0x05, 0x2b, 0x81, 0x04, 0x00, 0x21, 0x03, 0x3a, 0x00, 0x04,
  0x56, 0x31, 0xb8, 0xc7, 0x24, 0x72, 0xfe, 0x77, 0x40, 0x45, 0x17, 0x79,
  0xb4, 0x8a, 0xdb, 0xd7, 0x03, 0x38, 0x39, 0x39, 0xda, 0xf8, 0xd8, 0xbe,
  0x96, 0x73, 0x48, 0xe2, 0xab, 0x07, 0x6b, 0x64, 0xed, 0xae, 0x6f, 0xfa,
  0xa4, 0x5e, 0x5c, 0xa6, 0x26, 0x2c, 0x7a, 0x94, 0xef, 0xad, 0x4b, 0xb5,
  0x43, 0xb9, 0x97, 0x50, 0x28, 0xd0, 0xdf, 0x7d
};
const unsigned int root_ec_pub_der_len = 80;
```
